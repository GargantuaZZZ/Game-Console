/**
 * These arguments were used when this file was generated. They will be automatically applied on subsequent loads
 * via the GUI or CLI. Run CLI with '--help' for additional information on how to override these arguments.
 * @cliArgs --device "MSPM0G350X" --package "LQFP-64(PM)" --part "Default" --product "mspm0_sdk@1.20.01.06"
 * @versions {"tool":"1.18.1+3343"}
 */

/**
 * Import the modules used in this configuration.
 */
const DAC12  = scripting.addModule("/ti/driverlib/DAC12");
const GPIO   = scripting.addModule("/ti/driverlib/GPIO", {}, false);
const GPIO1  = GPIO.addInstance();
const GPIO2  = GPIO.addInstance();
const GPIO3  = GPIO.addInstance();
const SPI    = scripting.addModule("/ti/driverlib/SPI", {}, false);
const SPI1   = SPI.addInstance();
const SPI2   = SPI.addInstance();
const SYSCTL = scripting.addModule("/ti/driverlib/SYSCTL");
const TIMER  = scripting.addModule("/ti/driverlib/TIMER", {}, false);
const TIMER1 = TIMER.addInstance();

/**
 * Write custom configuration values to the imported modules.
 */
const gate8  = system.clockTree["MFPCLKGATE"];
gate8.enable = true;

DAC12.dacOutputPinEn           = true;
DAC12.dacConfigureDMA          = true;
DAC12.dacFIFOEn                = true;
DAC12.dacFIFOThresh            = "TWO_QTRS_EMPTY";
DAC12.dacSampleTimerRate       = "1M";
DAC12.dacEnabledInterrupts     = ["DMA_DONE"];
DAC12.OutPinConfig.$name       = "ti_driverlib_gpio_GPIOPinGeneric3";
DAC12.DMA_CHANNEL.$name        = "DMA_CH0";
DAC12.DMA_CHANNEL.addressMode  = "b2f";
DAC12.DMA_CHANNEL.srcLength    = "HALF_WORD";
DAC12.DMA_CHANNEL.dstLength    = "HALF_WORD";
DAC12.DMA_CHANNEL.srcIncrement = "INCREMENT";

const Board = scripting.addModule("/ti/driverlib/Board", {}, false);

GPIO1.$name                   = "LEDs";
GPIO1.associatedPins.create(7);
GPIO1.associatedPins[0].$name = "LED1";
GPIO1.associatedPins[1].$name = "LED2";
GPIO1.associatedPins[2].$name = "LED3";
GPIO1.associatedPins[3].$name = "LED4";
GPIO1.associatedPins[4].$name = "LED5";
GPIO1.associatedPins[5].$name = "LED6";
GPIO1.associatedPins[6].$name = "LED7";

GPIO2.$name                       = "KEYs";
GPIO2.associatedPins.create(7);
GPIO2.associatedPins[0].$name     = "KEY1";
GPIO2.associatedPins[0].direction = "INPUT";
GPIO2.associatedPins[1].$name     = "KEY2";
GPIO2.associatedPins[1].direction = "INPUT";
GPIO2.associatedPins[2].$name     = "KEY3";
GPIO2.associatedPins[2].direction = "INPUT";
GPIO2.associatedPins[3].$name     = "KEY4";
GPIO2.associatedPins[3].direction = "INPUT";
GPIO2.associatedPins[4].$name     = "KEY5";
GPIO2.associatedPins[4].direction = "INPUT";
GPIO2.associatedPins[5].$name     = "KEY6";
GPIO2.associatedPins[5].direction = "INPUT";
GPIO2.associatedPins[6].$name     = "KEY7";
GPIO2.associatedPins[6].direction = "INPUT";

GPIO3.$name                   = "Others";
GPIO3.associatedPins[0].$name = "CS_flash";

SPI1.$name                              = "SPI_flash";
SPI1.frameFormat                        = "MOTO3";
SPI1.sclkPinConfig.$name                = "ti_driverlib_gpio_GPIOPinGeneric0";
SPI1.sclkPinConfig.direction            = scripting.forceWrite("OUTPUT");
SPI1.sclkPinConfig.onlyInternalResistor = scripting.forceWrite(false);
SPI1.sclkPinConfig.passedPeripheralType = scripting.forceWrite("Digital");
SPI1.mosiPinConfig.$name                = "ti_driverlib_gpio_GPIOPinGeneric1";
SPI1.mosiPinConfig.direction            = scripting.forceWrite("OUTPUT");
SPI1.mosiPinConfig.hideOutputInversion  = scripting.forceWrite(false);
SPI1.mosiPinConfig.onlyInternalResistor = scripting.forceWrite(false);
SPI1.mosiPinConfig.passedPeripheralType = scripting.forceWrite("Digital");
SPI1.misoPinConfig.$name                = "ti_driverlib_gpio_GPIOPinGeneric2";
SPI1.misoPinConfig.onlyInternalResistor = scripting.forceWrite(false);
SPI1.misoPinConfig.passedPeripheralType = scripting.forceWrite("Digital");

SPI2.$name                              = "SPI_screen";
SPI2.sclkPinConfig.$name                = "ti_driverlib_gpio_GPIOPinGeneric4";
SPI2.sclkPinConfig.direction            = scripting.forceWrite("OUTPUT");
SPI2.sclkPinConfig.onlyInternalResistor = scripting.forceWrite(false);
SPI2.sclkPinConfig.passedPeripheralType = scripting.forceWrite("Digital");
SPI2.mosiPinConfig.$name                = "ti_driverlib_gpio_GPIOPinGeneric5";
SPI2.mosiPinConfig.direction            = scripting.forceWrite("OUTPUT");
SPI2.mosiPinConfig.hideOutputInversion  = scripting.forceWrite(false);
SPI2.mosiPinConfig.onlyInternalResistor = scripting.forceWrite(false);
SPI2.mosiPinConfig.passedPeripheralType = scripting.forceWrite("Digital");
SPI2.misoPinConfig.$name                = "ti_driverlib_gpio_GPIOPinGeneric6";
SPI2.misoPinConfig.onlyInternalResistor = scripting.forceWrite(false);
SPI2.misoPinConfig.passedPeripheralType = scripting.forceWrite("Digital");
SPI2.cs0PinConfig.$name                 = "ti_driverlib_gpio_GPIOPinGeneric7";
SPI2.cs0PinConfig.direction             = scripting.forceWrite("OUTPUT");
SPI2.cs0PinConfig.hideOutputInversion   = scripting.forceWrite(false);
SPI2.cs0PinConfig.onlyInternalResistor  = scripting.forceWrite(false);
SPI2.cs0PinConfig.passedPeripheralType  = scripting.forceWrite("Digital");

SYSCTL.forceDefaultClkConfig = true;
SYSCTL.clockTreeEn           = true;

TIMER1.$name       = "TIMER_KEYs";
TIMER1.timerPeriod = "1ms";
TIMER1.timerClkSrc = "LFCLK";
TIMER1.interrupts  = ["ZERO"];
TIMER1.timerMode   = "PERIODIC";

/**
 * Pinmux solution for unlocked pins/peripherals. This ensures that minor changes to the automatic solver in a future
 * version of the tool will not impact the pinmux you originally saw.  These lines can be completely deleted in order to
 * re-solve from scratch.
 */
DAC12.peripheral.$suggestSolution             = "DAC0";
DAC12.peripheral.OutPin.$suggestSolution      = "PA15";
DAC12.DMA_CHANNEL.peripheral.$suggestSolution = "DMA_CH0";
Board.peripheral.$suggestSolution             = "DEBUGSS";
Board.peripheral.swclkPin.$suggestSolution    = "PA20";
Board.peripheral.swdioPin.$suggestSolution    = "PA19";
GPIO1.associatedPins[0].pin.$suggestSolution  = "PB14";
GPIO1.associatedPins[1].pin.$suggestSolution  = "PB15";
GPIO1.associatedPins[2].pin.$suggestSolution  = "PB16";
GPIO1.associatedPins[3].pin.$suggestSolution  = "PA12";
GPIO1.associatedPins[4].pin.$suggestSolution  = "PA13";
GPIO1.associatedPins[5].pin.$suggestSolution  = "PB17";
GPIO1.associatedPins[6].pin.$suggestSolution  = "PB18";
GPIO2.associatedPins[0].pin.$suggestSolution  = "PB19";
GPIO2.associatedPins[1].pin.$suggestSolution  = "PA21";
GPIO2.associatedPins[2].pin.$suggestSolution  = "PA22";
GPIO2.associatedPins[3].pin.$suggestSolution  = "PB20";
GPIO2.associatedPins[4].pin.$suggestSolution  = "PB21";
GPIO2.associatedPins[5].pin.$suggestSolution  = "PB22";
GPIO2.associatedPins[6].pin.$suggestSolution  = "PB23";
GPIO3.associatedPins[0].pin.$suggestSolution  = "PB13";
SPI1.peripheral.$suggestSolution              = "SPI1";
SPI1.peripheral.sclkPin.$suggestSolution      = "PA17";
SPI1.peripheral.mosiPin.$suggestSolution      = "PA18";
SPI1.peripheral.misoPin.$suggestSolution      = "PA16";
SPI2.peripheral.$suggestSolution              = "SPI0";
SPI2.peripheral.sclkPin.$suggestSolution      = "PA11";
SPI2.peripheral.mosiPin.$suggestSolution      = "PA14";
SPI2.peripheral.misoPin.$suggestSolution      = "PA10";
SPI2.peripheral.cs0Pin.$suggestSolution       = "PA2";
TIMER1.peripheral.$suggestSolution            = "TIMA0";
